//---------------------------------------------------------------------------
// 
//  УЧЕБНЫЙ ПРОЕКТ
//  Использование таймеров для генерации тональных сигналов 
//  Copyright (C) 2016 МИРЭА
//
//---------------------------------------------------------------------------

#include "stm32_p407.h"                 //Файл конфигурации отладочной платы STM32-P407
#include <stdlib.h>                     //Заголовочный файл с определением функции rand()

/*
   Справка: Частоты музыкальных тонов
 
  Индекс  Нота  Частота   |  Индекс  Нота  Частота   |  Индекс  Нота  Частота   |  Индекс  Нота  Частота
                  Гц      |                  Гц      |                  Гц      |                  Гц
                          |                          |                          |
     0     до    261.63   |    12     до    523.25   |    24     до   1046.50   |    36     до   2093.01
     1           277.18   |    13           554.37   |    25          1108.73   |    37          2217.46
     2     ре    293.66   |    14     ре    587.33   |    26     ре   1174.66   |    38     ре   2349.32
     3           311.13   |    15           622.25   |    27          1244.51   |    39          2489.02
     4     ми    329.63   |    16     ми    659.26   |    28     ми   1318.51   |    40     ми   2637.02
     5     фа    349.23   |    17     фа    698.46   |    29     фа   1396.91   |    41     фа   2793.83
     6           369.99   |    18           739.99   |    30          1479.98   |    42          2960.00
     7    соль   392.00   |    19    соль   783.99   |    31    соль  1567.98   |    43    соль  3135.96
     8           415.30   |    20           830.61   |    32          1661.22   |    44          3322.44
     9     ля    440      |    21     ля    880.00   |    33     ля   1760.00   |    45     ля   3520
    10           466.16   |    22           932.33   |    34          1864.66   |    46          3729.31
    11     си    493.88   |    23     си    987.77   |    35     си   1975.54   |    47     си   3951.07
                                                                                |    48     до   4186.02
*/

//Таблица частот музыкальных тонов (одна строка составляет октаву)
float ToneTable[] = 
{ 261.63,  277.18,  293.66,  311.13,  329.63,  349.23,  369.99,  392.00,  415.30,  440,  466.16,  493.88,
  523.25,  554.37,  587.33,  622.25,  659.26,  698.46,  739.99,  783.99,  830.61,  880,  932.33,  987.77, 
 1046.50, 1108.73, 1174.66, 1244.51, 1318.51, 1396.91, 1479.98, 1567.98, 1661.22, 1760, 1864.66, 1975.54,
 2093.01, 2217.46, 2349.32, 2489.02, 2637.02, 2793.83, 2960.00, 3135.96, 3322.44, 3520, 3729.31, 3951.07,
 4186.02 };

//Прототипы вызываемых функций
void TimerConfig(void);
void ToneGeneration(Button_TypeDef Button, uint32_t ToneIndex);

//---------------------------------------------------------------------------
// ГЛАВНАЯ ФУНКЦИЯ 
int main()
{
  uint32_t Octave;
  
  //Инициализация органов управления
  STM_PBInit(BUTTON_TAMPER, BUTTON_MODE_GPIO);  //Кнопка TAMPER
  STM_PBInit(BUTTON_WAKEUP, BUTTON_MODE_GPIO);  //Кнопка  WAKEUP
  STM_PBInit(BUTTON_RIGHT, BUTTON_MODE_GPIO);   //Позиции джойстика
  STM_PBInit(BUTTON_LEFT, BUTTON_MODE_GPIO);
  STM_PBInit(BUTTON_UP, BUTTON_MODE_GPIO);
  STM_PBInit(BUTTON_DOWN, BUTTON_MODE_GPIO);
  STM_PBInit(BUTTON_SEL, BUTTON_MODE_GPIO);

  //Инициализация индикаторов
  STM_LEDInit(LED4); STM_LEDOff(LED4);

  //Конфигурирование таймера (см. файл tim_ton.c)
  TimerConfig();
  
  //Цикл в основной программе
  while (1)
  {
    //Проверка состояния кнопки TAMPER (октавный сдвиг) 
    Octave = STM_PBGetState(BUTTON_TAMPER) ? 0 : 12;
    //Проверка положения джойстика "Влево"
    if (STM_PBGetState(BUTTON_LEFT)) ToneGeneration(BUTTON_LEFT, Octave + 0);
    //Проверка положения джойстика "Вверх"
    if (STM_PBGetState(BUTTON_UP)) ToneGeneration(BUTTON_UP, Octave + 3);
    //Проверка положения джойстика "Вправо"
    if (STM_PBGetState(BUTTON_RIGHT)) ToneGeneration(BUTTON_RIGHT, Octave + 7);
    //Проверка положения джойстика "Выбор"
    if (STM_PBGetState(BUTTON_SEL)) ToneGeneration(BUTTON_SEL, Octave + 24);
    //Проверка положения джойстика "Вниз"
    if (STM_PBGetState(BUTTON_DOWN)) ToneGeneration(BUTTON_DOWN, rand() % 49);
    rand();

    //Проверка воздействия на кнопку WAKEUP, при нажатии - выход из цикла
    if (STM_PBGetState(BUTTON_WAKEUP)) break;
  }

  //Сброс процессора - завершение выполнения данной программы, запуск начального загрузчика
  NVIC_SystemReset();
}

//---------------------------------------------------------------------------
// ПОДПРОГРАММА ВЫДАЧИ ТОНАЛЬНОГО СИГНАЛА
// Входные параметры: Button    - номер (индекс) нажатой кнопки
//                    ToneIndex - индекс генерируемого тона по таблице ToneTable[]
void ToneGeneration(Button_TypeDef Button, uint32_t ToneIndex)
{
  STM_LEDOn(LED4);                             //Контрольная индикация
                                               //Расчет и загрузка в таймер коэффициента деления 
  TIM_SetAutoreload(TIM3, 1e6f / ToneTable[ToneIndex] - 1);
  TIM_Cmd(TIM3, ENABLE);                       //Разрешение работы таймера
  if (Button == BUTTON_DOWN) Delay_ms(300);    //Для одной из кнопок - временная задержка, 
  else while (STM_PBGetState(Button));         // для других - ожидание отпускания кнопки
  TIM_Cmd(TIM3, DISABLE);                      //Запрет работы таймера
  
  STM_LEDOff(LED4);
}

//---------------------------------------------------------------------------
