//---------------------------------------------------------------------------
// 
//  ДЕМОНСТРАЦИОННЫЙ ПРОЕКТ
//
//  Сигнализатор (вариант 1)
//  Задание: при нажатии кнопки сформировать звуковой сигнал с частотой 1 кГц и
//  длительностью 2 с. Светодиодный индикатор должен включаться на время
//  звукового сигнала и мигать остальное время. 
//
//  При реализации используется программная генерация выходного сигнала и
//  программная отработка временных интервалов.
//
//  Copyright (C) 2013 МГТУ МИРЭА
//
//---------------------------------------------------------------------------

#include "stm32f4xx.h"                  //Константы и структуры данных для процессоров семейства STM32F4xx
#include "stm32_ports.h"                //Функции работы с портами

#define BLINK_PERIOD   1000000          //Периодичность переключения индикатора (в программных циклах)
#define PERIOD_TONE    500              //Полупериод тонального сигнала в микросекундах - соответствует 1 кГц
#define DURATION_TONE  2000             //Длительность тонального сигнала в периодах частоты 1 кГц

//---------------------------------------------------------------------------
// ПОДПРОГРАММА ВРЕМЕННОЙ ЗАДЕРЖКИ
// Входной аргумент: значение задержки в микросекундах.
// Величина задержки отрабатывается приблизительно, зависит от уровня оптимизации компиляции.
void Delay_us(int us)
{
  volatile int i;
  while (--us) { i = 27; while (--i); }
}

//---------------------------------------------------------------------------
// ГЛАВНАЯ ФУНКЦИЯ 
int main()
{
  int i;                                //Текущий параметр цикла
  int blink_counter = 0;                //Счетчик для формирования периода переключения индикатора
  bool ButtonPress = false;             //Признак нажатия кнопки

  //Инициализация разрядов порта с органами управления:
  // основная кнопка (TAMPER) - подключена к разряду 13 порта PC, подтянута к '1', замыкает на '0' 
  PortInputInit(GPIOC, GPIO_Pin_13, GPIO_PuPd_UP, 0);
  // отладочная кнопка (WAKEUP) - подключена к разряду 0 порта PA, подтянута к '0', замыкает на '1'
  PortInputInit(GPIOA, GPIO_Pin_0, GPIO_PuPd_DOWN, 0);

  //Инициализация разряда 6 порта PF с индикатором (включение индикатора - лог. '1')
  PortOutputInit(GPIOF, GPIO_Pin_6);

  //Инициализация разряда 1 порта PB со звуковым излучателем 
  PortOutputInit(GPIOB, GPIO_Pin_1);
  
  //Основной цикл
  while (1)
  {
    //Проверка нажатия основной кнопки
    if (PortReadBit(GPIOC, GPIO_Pin_13))
    { //Кнопка не нажата
      ButtonPress = false;                          //Сброс признака нажатия кнопки
      if (++blink_counter >= BLINK_PERIOD)          //Инкремент и проверка счетчика периода мигания
        blink_counter = 0,                          //Если счетчик достиг заданного значения, его сброс
        PortToggleBit(GPIOF, GPIO_Pin_6);           // и переключение индикатора
    }
    else
    { //Кнопка нажата
      //Проверка установки признака нажатия
      if (!ButtonPress)
      { //Здесь признак нажатия не установлен
        ButtonPress = true;                         //Установка признака нажатия
        PortWriteBit(GPIOF, GPIO_Pin_6, 1);         //Включение индикатора
        for (i = 0; i < DURATION_TONE; i++)         //Цикл по периодам тонального сигнала
        {                                           //В цикле:
          PortWriteBit(GPIOB, GPIO_Pin_1, 1);       // - выдача лог. '1' на звуковой излучатель
          Delay_us(PERIOD_TONE);                    // - задержка на полпериода сигнала
          PortWriteBit(GPIOB, GPIO_Pin_1, 0);       // - выдача лог. '0' на звуковой излучатель
          Delay_us(PERIOD_TONE);                    // - задержка на полпериода сигнала
        }
        PortWriteBit(GPIOF, GPIO_Pin_6, 0);         //Выключение индикатора
      }  
    }
    
    //Отладочный оператор:
    // если нажата отладочная кнопка, сброс процессора - выход из программы 
    if (PortReadBit(GPIOA, GPIO_Pin_0)) NVIC_SystemReset();
  }

}

//---------- Конец файла main1.c --------------------------------------------
