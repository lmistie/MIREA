//---------------------------------------------------------------------------
// 
//  УЧЕБНЫЙ ПРОЕКТ
//  Программирование вычислительных операций, форматированный вывод
//
//  В демонстрационном примере осуществляется нахождение среднего арифметического
//  элементов массива, предварительно заполненного случайными числами.
//  Исходные элементы - целые 32-разрядные. Два варианта: элементы знаковые и беззнаковые. 
//
//  При выполнении собственного задания закомментировать или удалить строки с пометкой Тест
//
//  В режиме симуляции активно макроопределение SIMUL (задано в свойствах проекта).
//  Возможен вывод в окно, которое открывается/закрывается в режиме отладки
//  выбором пункта меню "View / Serial Windows / Debug (printf) Viewer" 
//
//--------------------------------------------------------------------------------------

#ifndef SIMUL
#include "stm32_p407.h"                 //Файл конфигурации отладочной платы STM32-P407
#include "lcd.h"                        //Функции для работы с дисплеем
#endif
#include <math.h>                       //Математические функции стандартной библиотеки C/C++
#include "arm_math.h"                   //Определения и функции библиотеки CMSIS DSP Library
#include <stdio.h>                      //Функции ввода-вывода (в данном проекте - printf)
#include <stdlib.h>                     //Функции общего назначения (в данном проекте - rand)
#include "debug_printf.h"               //Определения для вывода в отладочное окно


int TestData[256];                              //Тест (массив исходных данных)

//------------------ Главная функция ---------------------------------------------------

int main()
{
  int* address = TestData;                      //Тест (указатель на начало массива)
  int number = sizeof(TestData)/sizeof(int);    //Тест (число элементов массива)
  float sum;                                    //Тест (суммма элементов)
  float mean;                                   //Тест (среднее арифметическое)
  int i;                                        //Тест (счетчик-индекс элементов)
  for (i = 0; i < number; i++)                  //Тест
    TestData[i] = rand() << 1;                  //Тест
  
  #ifndef SIMUL
  //Инициализация кнопки WAKEUP выхода из программы
  STM_PBInit(BUTTON_WAKEUP, BUTTON_MODE_GPIO); 

  //Инициализация дисплея
  LCD_Init(); LCD_Clear(1);
  LCD_FontSize(9);
  #endif

  //Решаемая задача
  //===================================================================================
  for (i = 0, sum = 0; i < number; i++)                                         //Тест |
  {                                                                             //Тест |
    sum += (float)*(address+i);                                                 //Тест |
  }                                                                             //Тест |
  mean = sum / number;                                                          //Тест |
  LCD_printf(" *** РЕЗУЛЬТАТ ***\r\n");                                         //Тест |
  LCD_printf("Вариант 1 (знак)\r\n N=%d\r\n sum =%g\r\n mean=%g\r\n",           //Тест | 
             number, sum, mean);                                                //Тест |
                                                                                //Тест |
  for (i = 0, sum = 0; i < number; i++)                                         //Тест |
  {                                                                             //Тест |
    sum += (float)(unsigned int)*(address+i);                                   //Тест |
  }                                                                             //Тест |
  mean = sum / number;                                                          //Тест |
  LCD_printf("Вариант 2 (б/зн)\r\n N=%d\r\n sum =%g\r\n mean=%g\r\n",           //Тест |
             number, sum, mean);                                                //Тест |
  //===================================================================================

  //Окончание
  while (1)
  { 
    #ifndef SIMUL
    //Проверка нажатия кнопки WAKEUP завершения программы
    if (STM_PBGetState(BUTTON_WAKEUP)) NVIC_SystemReset();
    #endif
  }
}

//------------------ Конец файла -------------------------------------------------------
