//---------------------------------------------------------------------------
// 
//  ДЕМОНСТРАЦИОННЫЙ ПРОЕКТ
//
//  Сигнализатор (вариант 2)
//  Задание: при нажатии кнопки сформировать звуковой сигнал с частотой 1 кГц и
//  длительностью 2 с. Светодиодный индикатор должен включаться на время
//  звукового сигнала и мигать остальное время. 
//
//  При реализации используется генерация выходного сигнала с помощью одного
//  таймера и отработка его длительности посредством другого.
//  Демонстрируется работа двух таймеров в режиме ведущего-ведомого.
//
//  Copyright (C) 2013 МГТУ МИРЭА
//
//---------------------------------------------------------------------------

#include "stm32f4xx.h"                  //Константы и структуры данных для процессоров семейства STM32F4xx
#include "stm32_ports.h"                //Функции работы с портами

#define BLINK_PERIOD   1000000          //Периодичность переключения индикатора (в программных циклах)

void TimerGenerationConfig(void);       //Прототипы функций, определены в файле timer.c
void TimerDurationConfig(void);

//---------------------------------------------------------------------------
// ГЛАВНАЯ ФУНКЦИЯ 
int main()
{
  int blink_counter = 0;                //Счетчик для формирования периода переключения индикатора
  bool ButtonPress = false;             //Признак нажатия кнопки

  //Инициализация разрядов порта с органами управления:
  // основная кнопка (TAMPER) - подключена к разряду 13 порта PC, подтянута к '1', замыкает на '0' 
  PortInputInit(GPIOC, GPIO_Pin_13, GPIO_PuPd_UP, 0);
  // отладочная кнопка (WAKEUP) - подключена к разряду 0 порта PA, подтянута к '0', замыкает на '1'
  PortInputInit(GPIOA, GPIO_Pin_0, GPIO_PuPd_DOWN, 0);

  //Инициализация разряда 6 порта PF с индикатором (включение индикатора - лог. '1')
  PortOutputInit(GPIOF, GPIO_Pin_6);

  //Инициализация таймера-генератора тонального сигнала - звуковой излучатель подключен к его выходу 
  TimerGenerationConfig();

  //Инициализация таймера-формирователя длительности звукового сигнала 
  TimerDurationConfig();
  
  //Основной цикл
  while (1)
  {
    //Проверка нажатия основной кнопки
    if (PortReadBit(GPIOC, GPIO_Pin_13))
      //Если кнопка не нажата, сброс признака нажатия кнопки
      ButtonPress = false;
    else
    { //Кнопка нажата, проверка установки признака нажатия
      if (!ButtonPress)
      { //Здесь признак нажатия не установлен
        ButtonPress = true;                       //Установка признака нажатия
        TIM_Cmd(TIM1, ENABLE);                    //Запуск таймера-формирователя длительности сигнала
      }  
    }

    //Управление индикатором посредством флага разрешения работы таймера-формирователя
    if (TIM1->CR1 & TIM_CR1_CEN)                  //CR1 - регистр управления, TIM_CR1_CEN - маска флага
      PortWriteBit(GPIOF, GPIO_Pin_6, 1);         //Если таймер работает, включение индикатора
    else                                          //Если таймер остановлен:
      if (++blink_counter >= BLINK_PERIOD)        //Инкремент и проверка счетчика периода мигания
        blink_counter = 0,                        //Если счетчик достиг заданного значения, его сброс
        PortToggleBit(GPIOF, GPIO_Pin_6);         // и переключение индикатора

    //Отладочный оператор:
    // если нажата отладочная кнопка, сброс процессора - выход из программы 
    if (PortReadBit(GPIOA, GPIO_Pin_0)) NVIC_SystemReset();
  }

}

//---------- Конец файла main2.c --------------------------------------------
